## block/Kconfig
```kconfig
# SPDX-License-Identifier: GPL-2.0
#
# Block layer core configuration
#
if BLOCK

config MQ_IOSCHED_SSG
	tristate "SamSung Generic I/O scheduler"
	default n
	help
	  SamSung Generic IO scheduler.

config MQ_IOSCHED_SSG_CGROUP
	tristate "Control Group for SamSung Generic I/O scheduler"
	default n
	depends on BLK_CGROUP
	depends on MQ_IOSCHED_SSG
	help
	  Control Group for SamSung Generic IO scheduler.

endif # BLOCK
```

## drivers/input/touchscreen/ft8057p_spi/Kconfig
```kconfig
# FocalTech FT8057P SPI touchscreen

config TOUCHSCREEN_FT8057P_SPI
	tristate "FocalTech FT8057P SPI touchscreen for Gale"
	depends on INPUT_TOUCHSCREEN && MACH_GALE && SPI && OF && GPIOLIB
	depends on DRM_MEDIATEK_V2
	depends on DRM_PANEL_C3UV_35_03_0B_VDO
	select TOUCHSCREEN_COMMON
	default m
	help
	  Build support for Gale devices using the FocalTech FT8057P SPI panel.
```

## drivers/input/touchscreen/icnl9916_spi/Kconfig
```kconfig
config TOUCHSCREEN_CHIPONE
	tristate "Chipone ICNL9916 SPI touchscreen for Gale"
	depends on INPUT_TOUCHSCREEN && MACH_GALE && SPI && OF && GPIOLIB
	depends on DRM_MEDIATEK_V2
	depends on DRM_PANEL_C3UV_42_0F_0D_VDO
	select TOUCHSCREEN_COMMON
	default m
	help
	  Build support for Gale devices using the Chipone ICNL9916 SPI panel.
```

## drivers/input/touchscreen/nt36528_spi/Kconfig
```kconfig
config TOUCHSCREEN_NT36528_SPI
	tristate "Novatek NT36528 SPI touchscreen"
	depends on MACH_GALE && SPI && I2C && OF && INPUT
	depends on DRM_MEDIATEK_V2 && GPIOLIB && BACKLIGHT_CLASS_DEVICE
	depends on POWER_SUPPLY
	select TOUCHSCREEN_COMMON
	select DRM_PANEL_C3UV_43_02_0A_VDO
```

## drivers/misc/Kconfig
```kconfig
# SPDX-License-Identifier: GPL-2.0-only

config NTSYNC
	tristate "NT synchronization primitive emulation"
	default	n
	help
	  This module provides kernel support for emulation of Windows NT
	  synchronization primitives. It is not a hardware driver.

	  To compile this driver as a module, choose M here: the
	  module will be called ntsync.

	  If unsure, say N.

source "$(KCONFIG_EXT_PREFIX)drivers/misc/mediatek/Kconfig"
```
